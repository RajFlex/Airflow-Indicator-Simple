/*
 * This code shows Text on the LHS and a tick on the RHS of the PCD 8544 screen 
 * shows digital pin output on the LHS of the screen and tick or a cross on the RHS accordingly
 * Adding ABP2 sensor 
 */
#include "U8glib.h"
#include<Arduino.h>
#include<SPI.h>

U8GLIB_PCD8544 u8g(8, 4, 7, 5, 6);  // CLK=8, DIN=4, CE=7, DC=5, RST=6

double press_counts = 0; // digital pressure reading [counts]
double temp_counts = 0; // digital temperature reading [counts]
double pressure = 0; // pressure reading [bar, psi, kPa, etc.]
double temperature = 0; // temperature reading in deg C
double outputmax = 15099494; // output at maximum pressure [counts]
double outputmin = 1677722; // output at minimum pressure [counts]
double pmax = 1; // maximum value of pressure range [bar, psi, kPa, etc.]
double pmin = 0; // minimum value of pressure range [bar, psi, kPa, etc.]
double percentage = 0; // holds percentage of full scale data
char printBuffer[200], cBuff[20], percBuff[20], pBuff[20], tBuff[20];
int ref_pressure = 0.003;

const uint8_t tick_bitmap[] PROGMEM =  {
0x00, 0x00, 0x00, 0x00, 0x00, 0x00, 0x00, 0x00, 0x00, 0x00, 0x00, 0x00, 0x00, 0x00, 0x00, 0x00,
0x00, 0x00, 0x00, 0x00, 0x00, 0x00, 0x00, 0x00, 0x00, 0x00, 0x00, 0x00, 0x0E, 0x00, 0x00, 0x00,
0x00, 0x00, 0x3F, 0x00, 0x00, 0x00, 0x00, 0x00, 0x3F, 0x80, 0x00, 0x00, 0x00, 0x00, 0x7F, 0x80,
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0x00, 0x00, 
};

const uint8_t cross_bitmap[] PROGMEM =  {
0x00, 0x00, 0x00, 0x00, 0x00, 0x00, 0x00, 0x00, 0x00, 0x00, 0x00, 0x00, 0x00, 0x00, 0x00, 0x00,
0x00, 0x00, 0x00, 0x60, 0x00, 0x00, 0x01, 0x80, 0x00, 0xF0, 0x00, 0x00, 0x03, 0xC0, 0x01, 0xF8,
0x00, 0x00, 0x07, 0xE0, 0x03, 0xFC, 0x00, 0x00, 0x0F, 0xF0, 0x0F, 0xFE, 0x00, 0x00, 0x1F, 0xFC,
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0x00, 0x00, 
};

void setup(void) {
//  analogWrite(backlight_pin, 50);  /* Set the Backlight intensity */
  Serial.begin (9600);
  pinMode (9, OUTPUT);
  digitalWrite (9, HIGH);

   while (!Serial) {
 delay(10);
 }
 sprintf(printBuffer, "\nStatus Register, 24-bit Sensor data, Digital Pressure Counts,\
 Percentage of full scale pressure,Pressure Output, Temperature\n");
 Serial.println(printBuffer);
 SPI.begin();
 pinMode(10, OUTPUT); // pin 10 as SS
 digitalWrite(10, HIGH); // set SS High

}

void draw_1(void) {
  u8g.drawBitmapP( 37, 0, 6, 50, tick_bitmap);  // put bitmap ( 37, 0, 6, 50, brainy_bitmap)
  u8g.setFont(u8g_font_profont11);  // select font
  u8g.drawStr(0, 15, "Case 1");  // put string of display at position X, Y
  u8g.drawStr(0, 35, pBuff);
  u8g.setPrintPos(15, 15);  // set position
  u8g.setPrintPos(15, 35);
//  u8g.drawStr(20, 35, "kPa");
}

void draw_2(void) {
  u8g.drawBitmapP( 37, 0, 6, 50, cross_bitmap);  // put bitmap ( 37, 0, 6, 50, brainy_bitmap)
  u8g.setFont(u8g_font_profont11);  // select font
  u8g.drawStr(0, 15, "Case 2");  // put string of display at position X, Y
  u8g.drawStr(0, 35, pBuff);
  u8g.setPrintPos(15, 15);  // set position
  u8g.setPrintPos(15, 35);
//  u8g.drawStr(20, 35, "kPa");
}

void loop(void) {
  
 while (1) {
 uint8_t data[7] = {0xFA, 0x00, 0x00, 0x00, 0x00, 0x00, 0x00}; // holds output data
 uint8_t cmd[3] = {0xAA, 0x00, 0x00}; // command to be sent
 SPI.beginTransaction(SPISettings(200000, MSBFIRST, SPI_MODE0)); //SPI at 200kHz
 digitalWrite(10, LOW); // set SS Low
 SPI.transfer(cmd, 3); // send Read Command
 digitalWrite(10, HIGH); // set SS High
 delay(10); // wait for conversion
 digitalWrite(10, LOW);
 SPI.transfer(data, 7);
 digitalWrite(10, HIGH);
 SPI.endTransaction();
 press_counts = data[3] + data[2] * 256 + data[1] * 65536; // calculate digital pressure counts
 temp_counts = data[6] + data[5] * 256 + data[4] * 65536; // calculate digital temperature counts
 temperature = (temp_counts * 200 / 16777215) - 50; // calculate temperature in deg c
 percentage = (press_counts / 16777215) * 100; // calculate pressure as percentage of full scale
 //calculation of pressure value according to equation 2 of datasheet
 pressure = ((press_counts - outputmin) * (pmax - pmin)) / (outputmax - outputmin) + pmin;
 dtostrf(press_counts, 4, 1, cBuff);
 dtostrf(percentage, 4, 3, percBuff);
 dtostrf(pressure, 4, 3, pBuff);
 dtostrf(temperature, 4, 3, tBuff);

  sprintf(printBuffer, "%x\t%2x %2x %2x\t%s\t%s\t%s\t%s \n", data[0], data[1], data[2], data[3],
 cBuff, percBuff, pBuff, tBuff);
 Serial.print(printBuffer);
 delay(10);

   Serial.println (digitalRead (9), DEC);
  delay (500);
  digitalWrite (9, !digitalRead (9));

// convert char to int for comparison



u8g.firstPage();  
  do {
    if (pBuff >= (char)0.003)
    {
      draw_1();
    }
    else if (pBuff <= (char)0.003)
    {
      draw_2();
    }
  } while( u8g.nextPage() );
  
  delay(5);  // Delay of 5sec before accessing DHT11 (min - 2sec)
  
// break; // why is this affecting the text display?
 }
  
}
